/**
 * @file test_pan_temp_estimator.c
 * @brief sensor-r3 C1 Kalman filter: float port vs the Python double reference.
 *
 * Golden vectors: pan_temp_estimator_vectors.h, generated by
 * output/temper-sensor-r3/firmware/export_vectors.py (step, ramp, h_c
 * extremes, noise). Bar: |C float - Python double| <= 0.05 K on every sample.
 */

#include <math.h>
#include <stdio.h>

#include "unity/unity.h"
#include "../components/control/pan_temp_estimator.h"
#include "pan_temp_estimator_vectors.h"

static pte_params_t vector_params(void)
{
    pte_params_t p;
    pte_default_params(&p);
    p.c_cap_j_per_k = (float)PTV_C_CAP;
    p.c_el_j_per_k = (float)PTV_C_EL;
    p.g_bond_w_per_k = (float)PTV_G_BOND;
    p.g_leak_w_per_k = (float)PTV_G_LEAK;
    p.contact_area_m2 = (float)PTV_AREA;
    p.h_nom_w_per_m2k = (float)PTV_H_NOM;
    p.sigma_k = (float)PTV_SIGMA;
    return p;
}

static void test_defaults_are_handoff_constants(void)
{
    pte_params_t p;
    pte_default_params(&p);
    TEST_ASSERT_FLOAT_WITHIN(1e-6f, 0.0404f, p.c_cap_j_per_k);
    TEST_ASSERT_FLOAT_WITHIN(1e-7f, 0.008175f, p.c_el_j_per_k);
    TEST_ASSERT_FLOAT_WITHIN(1e-6f, 0.0612f, p.g_bond_w_per_k);
    TEST_ASSERT_FLOAT_WITHIN(1e-8f, 0.0008f, p.g_leak_w_per_k);
    TEST_ASSERT_FLOAT_WITHIN(1e-9f, 45.4e-6f, p.contact_area_m2);
    TEST_ASSERT_FLOAT_WITHIN(1e-3f, 1300.0f, p.h_nom_w_per_m2k);
    TEST_ASSERT_FLOAT_WITHIN(1e-6f, 0.1f, p.dt_s);
    TEST_ASSERT_EQUAL_UINT(5u, p.substeps);
    TEST_ASSERT_FLOAT_WITHIN(1e-6f, 0.2f, p.sigma_k);
}

static void test_rejects_non_physical_params(void)
{
    pte_t f;
    pte_params_t p;
    pte_default_params(&p);
    p.c_cap_j_per_k = 0.0f;
    TEST_ASSERT_FALSE(pte_init(&f, &p, 25.0f));
    pte_default_params(&p);
    p.substeps = 0u;
    TEST_ASSERT_FALSE(pte_init(&f, &p, 25.0f));
    pte_default_params(&p);
    p.h_nom_w_per_m2k = -1.0f;
    TEST_ASSERT_FALSE(pte_init(&f, &p, 25.0f));
    TEST_ASSERT_FALSE(pte_init(NULL, &p, 25.0f));
}

static void test_golden_vectors_within_0p05K(void)
{
    const pte_params_t p = vector_params();
    float worst_all = 0.0f;
    for (size_t c = 0; c < PTV_N_CASES; c++) {
        const ptv_case_t *v = &ptv_cases[c];
        pte_t f;
        TEST_ASSERT_TRUE(pte_init(&f, &p, (float)PTV_T0));
        float worst = 0.0f;
        double ss = 0.0;
        for (uint16_t i = 0; i < v->n; i++) {
            const float t_hat = pte_step(&f, v->y[i], v->rim[i]);
            const float d = fabsf(t_hat - v->ref[i]);
            ss += (double)d * d;
            if (d > worst) {
                worst = d;
            }
        }
        printf("  estimator vector %-26s n=%4u  max|C-Py| = %.5f K  rms = %.5f K\n", v->name, v->n,
               (double)worst, sqrt(ss / v->n));
        TEST_ASSERT_LESS_OR_EQUAL(0.05f, worst);
        if (worst > worst_all) {
            worst_all = worst;
        }
    }
    printf("  estimator vectors: worst max|C-Py| = %.5f K (bar 0.05 K)\n", (double)worst_all);
}

/* Steady state with constant element and sink: no flow through the bond, so
 * T_pan = y + G_leak (y - sink) / (h_nom A). */
static void test_steady_state_leak_correction(void)
{
    pte_params_t p;
    pte_default_params(&p);
    pte_t f;
    TEST_ASSERT_TRUE(pte_init(&f, &p, 25.0f));
    for (int i = 0; i < 3000; i++) {
        (void)pte_step(&f, 200.0f, 70.0f);
    }
    const float expected = 200.0f + p.g_leak_w_per_k * (200.0f - 70.0f) / (p.h_nom_w_per_m2k * p.contact_area_m2);
    TEST_ASSERT_FLOAT_WITHIN(0.05f, expected, pte_estimate(&f));
    TEST_ASSERT_FLOAT_WITHIN(0.01f, 0.0f, pte_rate(&f));
}

/* Covariance stays symmetric and positive on the diagonal over a long run. */
static void test_covariance_stays_well_formed(void)
{
    pte_params_t p;
    pte_default_params(&p);
    pte_t f;
    TEST_ASSERT_TRUE(pte_init(&f, &p, 25.0f));
    for (int i = 0; i < 36000; i++) {   /* one hour */
        const float y = 25.0f + 200.0f * (1.0f - expf(-(float)i / 3000.0f)) + 0.2f * sinf(0.37f * (float)i);
        (void)pte_step(&f, y, 60.0f);
    }
    for (int i = 0; i < PTE_NX; i++) {
        TEST_ASSERT_TRUE(f.P[i][i] > 0.0f);
        for (int j = 0; j < PTE_NX; j++) {
            TEST_ASSERT_EQUAL_FLOAT(f.P[i][j], f.P[j][i]);
        }
    }
    TEST_ASSERT_TRUE(isfinite(pte_estimate(&f)));
}

/* Predict-only (a rejected sample) leaves the estimate finite and moving. */
static void test_predict_only(void)
{
    pte_params_t p;
    pte_default_params(&p);
    pte_t f;
    TEST_ASSERT_TRUE(pte_init(&f, &p, 25.0f));
    for (int i = 0; i < 100; i++) {
        (void)pte_step(&f, 25.0f + 0.5f * (float)i * 0.1f, 28.0f);
    }
    const float before = pte_estimate(&f);
    const float after = pte_predict(&f, 28.0f);
    TEST_ASSERT_TRUE(isfinite(after));
    TEST_ASSERT_FLOAT_WITHIN(0.2f, before + 0.05f, after);
}

void run_pan_temp_estimator_tests(void)
{
    RUN_TEST(test_defaults_are_handoff_constants);
    RUN_TEST(test_rejects_non_physical_params);
    RUN_TEST(test_golden_vectors_within_0p05K);
    RUN_TEST(test_steady_state_leak_correction);
    RUN_TEST(test_covariance_stays_well_formed);
    RUN_TEST(test_predict_only);
}
